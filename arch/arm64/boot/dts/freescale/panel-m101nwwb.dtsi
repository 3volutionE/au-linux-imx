#include <dt-bindings/display/simple_panel_mipi_cmds.h>
	dsi-lanes = <4>;
	mode-skip-eot;
	mode-video;
	mode-video-burst;
/*	mode-video-hse; */
	panel-width-mm = <217>;
	panel-height-mm = <136>;
	spwg;

	display-timings {
		t_dsi: t_dsi_default {
			/* 37 MHz, PLL unlock troubles */
			clock-frequency = <70000000>;
/*
 * m101nwwb
 * ./panel_timings 70000000 60 1340 1470 815 833
 * h=1409(1340:1470) v=828(815:833) pixclk=69999120(70000000)
 * hblank=129 vblank=28
 *
 * Tianma - tm070jdhg30
 * ./panel_timings 70000000 60 1300 1444 803 901
 * h=1355(1300:1444) v=861(803:901) pixclk=69999300(70000000)
 *
 * The m101nwwb results satisfy both, so use them
 */
			hactive = <1280>;
			vactive = <800>;	/* Tianma */
			hback-porch = <5>;	/* 5 */
			hfront-porch = <123>;	/* 15 : 159 */
			vback-porch = <3>;	/* 2 : 101-tvfp */
			vfront-porch = <24>;	/* 3 : 99 */
			hsync-len = <1>;	/* 1 : 256 */
			vsync-len = <1>;	/* 1 : 128 */
			hsync-active = <0>;
			vsync-active = <0>;
			de-active = <1>;
		};
	};
