#include <dt-bindings/display/simple_panel_mipi_cmds.h>
	dsi-lanes = <4>;
	mode-skip-eot;
	mode-video;
	mode-video-burst;
	mipi-cmds-init = /bits/ 8 <
#if 0
		GEN_L3P(0xFF,0x98,0x81,0x03)
		GEN_S1P(0x01,0x00)
		GEN_S1P(0x02,0x00)
		GEN_S1P(0x03,0x56)
		GEN_S1P(0x04,0x13)
		GEN_S1P(0x05,0x00)
		GEN_S1P(0x06,0x06)
		GEN_S1P(0x07,0x02)
		GEN_S1P(0x08,0x00)
		GEN_S1P(0x09,0x01)
		GEN_S1P(0x0a,0x02)
		GEN_S1P(0x0b,0x00)
		GEN_S1P(0x0c,0x01)
		GEN_S1P(0x0d,0x01)
		GEN_S1P(0x0e,0x00)
		GEN_S1P(0x0f,0x15)
		GEN_S1P(0x10,0x15)
		GEN_S1P(0x11,0x00)
		GEN_S1P(0x12,0x00)
		GEN_S1P(0x13,0x00)
		GEN_S1P(0x14,0x00)
		GEN_S1P(0x15,0x00)
		GEN_S1P(0x16,0x00)
		GEN_S1P(0x17,0x00)
		GEN_S1P(0x18,0x00)
		GEN_S1P(0x19,0x00)
		GEN_S1P(0x1a,0x00)
		GEN_S1P(0x1b,0x00)
		GEN_S1P(0x1c,0x00)
		GEN_S1P(0x1d,0x00)
		GEN_S1P(0x1e,0x44)
		GEN_S1P(0x1f,0x80)
		GEN_S1P(0x20,0x02)
		GEN_S1P(0x21,0x03)
		GEN_S1P(0x22,0x00)
		GEN_S1P(0x23,0x00)
		GEN_S1P(0x24,0x00)
		GEN_S1P(0x25,0x00)
		GEN_S1P(0x26,0x00)
		GEN_S1P(0x27,0x00)
		GEN_S1P(0x28,0x73)
		GEN_S1P(0x29,0x03)
		GEN_S1P(0x2a,0x00)
		GEN_S1P(0x2b,0x00)
		GEN_S1P(0x2c,0x00)
		GEN_S1P(0x2d,0x00)
		GEN_S1P(0x2e,0x00)
		GEN_S1P(0x2f,0x00)
		GEN_S1P(0x30,0x00)
		GEN_S1P(0x31,0x00)
		GEN_S1P(0x32,0x00)
		GEN_S1P(0x33,0x00)
		GEN_S1P(0x34,0x04)
		GEN_S1P(0x35,0x00)
		GEN_S1P(0x36,0x07)
		GEN_S1P(0x37,0x00)
		GEN_S1P(0x38,0x01)
		GEN_S1P(0x39,0x00)
		GEN_S1P(0x3a,0x00)
		GEN_S1P(0x3b,0x00)
		GEN_S1P(0x3c,0x00)
		GEN_S1P(0x3d,0x00)
		GEN_S1P(0x3e,0x00)
		GEN_S1P(0x3f,0x00)
		GEN_S1P(0x40,0x00)
		GEN_S1P(0x41,0x00)
		GEN_S1P(0x42,0x00)
		GEN_S1P(0x43,0x00)
		GEN_S1P(0x44,0x00)
		GEN_S1P(0x50,0x00)
		GEN_S1P(0x51,0x23)
		GEN_S1P(0x52,0x44)
		GEN_S1P(0x53,0x67)
		GEN_S1P(0x54,0x89)
		GEN_S1P(0x55,0xab)
		GEN_S1P(0x56,0x00)
		GEN_S1P(0x57,0x11)
		GEN_S1P(0x58,0x22)
		GEN_S1P(0x59,0x33)
		GEN_S1P(0x5a,0x44)
		GEN_S1P(0x5b,0x55)
		GEN_S1P(0x5c,0x66)
		GEN_S1P(0x5d,0x77)
		GEN_S1P(0x5e,0x11)
		GEN_S1P(0x5f,0x11)
		GEN_S1P(0x60,0x0d)
		GEN_S1P(0x61,0x10)
		GEN_S1P(0x62,0x0c)
		GEN_S1P(0x63,0x0e)
		GEN_S1P(0x64,0x12)
		GEN_S1P(0x65,0x0f)
		GEN_S1P(0x66,0x13)
		GEN_S1P(0x67,0x06)
		GEN_S1P(0x68,0x02)
		GEN_S1P(0x69,0x02)
		GEN_S1P(0x6a,0x02)
		GEN_S1P(0x6b,0x02)
		GEN_S1P(0x6c,0x02)
		GEN_S1P(0x6d,0x02)
		GEN_S1P(0x6e,0x14)
		GEN_S1P(0x6f,0x15)
		GEN_S1P(0x70,0x02)
		GEN_S1P(0x71,0x00)
		GEN_S1P(0x72,0x01)
		GEN_S1P(0x73,0x08)
		GEN_S1P(0x74,0x02)
		GEN_S1P(0x75,0x11)
		GEN_S1P(0x76,0x0d)
		GEN_S1P(0x77,0x10)
		GEN_S1P(0x78,0x0c)
		GEN_S1P(0x79,0x0e)
		GEN_S1P(0x7a,0x12)
		GEN_S1P(0x7b,0x0f)
		GEN_S1P(0x7c,0x13)
		GEN_S1P(0x7d,0x08)
		GEN_S1P(0x7e,0x02)
		GEN_S1P(0x7f,0x02)
		GEN_S1P(0x80,0x02)
		GEN_S1P(0x81,0x02)
		GEN_S1P(0x82,0x02)
		GEN_S1P(0x83,0x02)
		GEN_S1P(0x84,0x14)
		GEN_S1P(0x85,0x15)
		GEN_S1P(0x86,0x02)
		GEN_S1P(0x87,0x00)
		GEN_S1P(0x88,0x01)
		GEN_S1P(0x89,0x06)
		GEN_S1P(0x8A,0x02)
		GEN_L3P(0xFF,0x98,0x81,0x04)
		GEN_S1P(0x6C,0x15)
		GEN_S1P(0x6E,0x2b)
		GEN_S1P(0x6F,0x33)
		GEN_S1P(0x3A,0x24)
		GEN_S1P(0x3B,0xc0)
		GEN_S1P(0x8D,0x15)
		GEN_S1P(0x87,0xba)
		GEN_S1P(0x26,0x76)
		GEN_S1P(0xB2,0xd1)
		GEN_S1P(0xB5,0x07)
		GEN_S1P(0x35,0x1f)
		GEN_L3P(0xFF,0x98,0x81,0x01)
		GEN_S1P(0x22,0x0a)
		GEN_S1P(0x31,0x00)
		GEN_S1P(0x40,0x53)
		GEN_S1P(0x53,0x4c)
		GEN_S1P(0x55,0x8a)
		GEN_S1P(0x50,0xaf)
		GEN_S1P(0x51,0xaf)
		GEN_S1P(0x60,0x14)
		GEN_S1P(0xA0,0x08)
		GEN_S1P(0xA1,0x22)
		GEN_S1P(0xA2,0x31)
		GEN_S1P(0xA3,0x11)
		GEN_S1P(0xA4,0x15)
		GEN_S1P(0xA5,0x29)
		GEN_S1P(0xA6,0x1e)
		GEN_S1P(0xA7,0x1f)
		GEN_S1P(0xA8,0xa9)
		GEN_S1P(0xA9,0x1d)
		GEN_S1P(0xAA,0x2a)
		GEN_S1P(0xAB,0x98)
		GEN_S1P(0xAC,0x1e)
		GEN_S1P(0xAD,0x1c)
		GEN_S1P(0xAE,0x51)
		GEN_S1P(0xAF,0x26)
		GEN_S1P(0xB0,0x2a)
		GEN_S1P(0xB1,0x57)
		GEN_S1P(0xB2,0x67)
		GEN_S1P(0xB3,0x39)
		GEN_S1P(0xC0,0x08)
		GEN_S1P(0xC1,0x22)
		GEN_S1P(0xC2,0x31)
		GEN_S1P(0xC3,0x11)
		GEN_S1P(0xC4,0x15)
		GEN_S1P(0xC5,0x29)
		GEN_S1P(0xC6,0x1e)
		GEN_S1P(0xC7,0x1f)
		GEN_S1P(0xC8,0xa9)
		GEN_S1P(0xC9,0x1d)
		GEN_S1P(0xCA,0x2a)
		GEN_S1P(0xCB,0x98)
		GEN_S1P(0xCC,0x1e)
		GEN_S1P(0xCD,0x1c)
		GEN_S1P(0xCE,0x52)
		GEN_S1P(0xCF,0x27)
		GEN_S1P(0xD0,0x2b)
		GEN_S1P(0xD1,0x55)
		GEN_S1P(0xD2,0x67)
		GEN_S1P(0xD3,0x39)
		GEN_L3P(0xFF,0x98,0x81,0x00)
		DCS_S0P(0x11)	/* Exit sleep */
		DELAY(200)
		DELAY(200)
		DELAY(200)
		DELAY(200)
		DCS_S0P(0x29)	/* MIPI_DCS_SET_DISPLAY_ON */
		DELAY(20)
#else
		GEN_S1P(0x83,0x00)	/* Page 0 */
		GEN_S1P(0x84,0x00)

		GEN_S1P(0x8F,0xA5)
		DELAY(5)
		DCS_S0P(0x01)		/* Reset */
		DELAY(20)
		GEN_S1P(0x8F,0xA5)
		GEN_S1P(0x83,0xAA)	/* Page 1 */
		GEN_S1P(0x84,0x11)
		GEN_S1P(0xA9,0x4B)

		GEN_S1P(0x83,0x00)	/* Page 0 */
		GEN_S1P(0x84,0x00)
		GEN_S1P(0x8F,0x00)	/* Leave reset */

		DELAY(50)
		GEN_S1P(0x3A, 0x77)	/* Interface pixel format, 24 BPP */
#endif
	>;
	mipi-cmds-enable = /bits/ 8 <
		DCS_S0P(0x11)		/* Exit sleep */
		DELAY(120)		/* 5 is what spec says */
		DCS_S0P(0x29)		/* MIPI_DCS_SET_DISPLAY_ON */
		DELAY(20)
	>;
	mipi-cmds-disable = /bits/ 8 <
		DCS_S0P(0x28)		/* MIPI_DCS_SET_DISPLAY_OFF */
		DELAY(20)
		DCS_S0P(0x10)		/* Enter sleep */
	>;
	panel-width-mm = <108>;
	panel-height-mm = <172>;

	display-timings {
		t_dsi: t_dsi_default {
			clock-frequency = <80000000>;
			hactive = <1200>;
			vactive = <1920>;
			hback-porch = <60>;
			hfront-porch = <80>;
			vback-porch = <25>;
			vfront-porch = <35>;
			hsync-len = <1>;
			vsync-len = <1>;
		};
	};
